## conf/layer.conf
```bitbake
# Currently, we do not have recipes in this layer.
BBPATH .= ":${LAYERDIR}"

# We do not have bbfiles yet but need to specify this for dependency management
# This will produce a warning, though.
BBFILE_COLLECTIONS += "meta-poky-extensions"
BBFILE_PATTERN_meta-poky-extensions = "^${LAYERDIR}/"
BBFILE_PRIORITY_meta-poky-extensions = "6"

LAYERDEPENDS_meta-poky-extensions = "core"
LAYERSERIES_COMPAT_meta-poky-extensions = "dunfell kirkstone"
```
